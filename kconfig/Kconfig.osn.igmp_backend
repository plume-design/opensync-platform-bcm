## kconfig/Kconfig.osn.igmp_backend
```kconfig
#
# BCM IGMP implementation
#
if PLATFORM_IS_BCM
orsource "../src/lib/osn/kconfig/Kconfig.osn.igmp_backend"
endif
```

## kconfig/Kconfig.osn.mld_backend
```kconfig
#
# BCM MLD implementation
#
if PLATFORM_IS_BCM
orsource "../src/lib/osn/kconfig/Kconfig.osn.mld_backend"
endif
```

## kconfig/Kconfig.osn.qos_backend
```kconfig
#
# BCM QoS implementation
#
orsource "../src/lib/osn/kconfig/Kconfig.osn.qos_backend"
```

## kconfig/Kconfig.osn.vlan_backend
```kconfig
#
# BCM VLAN implementation
#
if PLATFORM_IS_BCM
orsource "../src/lib/osn/kconfig/Kconfig.osn.vlan_backend"
endif
```

## kconfig/Kconfig.platform
```kconfig
menuconfig PLATFORM_IS_BCM
    bool "Broadcom"
    help
        Support for Broadcom SDK and derivatives

if PLATFORM_IS_BCM

menuconfig BCM_WIFI_DRIVER_PATH
    bool "Broadcom WiFi path"
    default n
    help
        This options avoid header redefined error
        in case of multiple selected platforms
        SDK_INCLUDE must not include BCM WiFi headers

if BCM_WIFI_DRIVER_PATH

config BCM_WIFI_IMPL_PATH
    string "Path to net/wl directory within Broadcom SDK"
    default "bcmdrivers/broadcom/net/wl"

config BCM_IMP_DRIVER_VERSION
    int "impl"
    default "29"

endif # BCM_WIFI_DRIVER_PATH

config BCM_USE_DPP
    bool "Use DPP for WPA Key Management"
    default n
    help
        Add support for WFA Easy Connect (DPP).

config BCM_REF_WIFI
    bool "Enable reference WiFi API implementation"
    default n
    help
        Given product may require non-standard integration.
        In such case it is expected that an integrator will
        implement all the necessary target_ functions.

        If the given product is generic enough it might be
        able to re-use as-is the reference implementation.

        If it can't be used as-is it is highly recommended
        to try to work it out so it can be generic enough to
        satisfy more products.

config BCMWL_EVENT_SOCK_FORCED_RESIZE
    bool "Allow forced resize of BCM event socket"
    default y
    help
        Disable this option on platforms that may have problems
        with force resize of BCM event socket.

config BCM_FORCE_FLOW_CACHE_FLUSH
    bool "Flush Flow Cache on open flow rule action"
    default y
    help
        Execute fcctl flush on open flow add/delete action.
        This should be enabled for BCM sdk older than 5.2.L07-p1.

config BCM_BOGUS_SURVEY_WORKAROUND
    bool "Workaround for bogus chanim_stats on very old BCM SDKs"
    default n
    help
        Enable this option on BCM platforms with old BCM SDKs
        that may have problems with chanim_stats reporting
        bogus information in some cases.

config BCMWL_VAP_DELIMITER
    string "VAP interface delimiter"
    default "."
    help
        Default delimiter in VAP interface name is .
        but some platforms use _

choice
    prompt "WiFi authentication"
    default BCM_USE_NAS

config BCM_USE_NAS
    bool "Use nas and eapd authentication"
    help
        This enables driving userspace daemons that are
        responsible for authenticating clients (AP role)
        and connecting to network (STA role).

        This is used on older BCM products/driver (11ac).

config BCM_USE_HOSTAP
    bool "Use hostapd and wpa_supplicant authentication"
    select HEALTHCHECK_HOSTAPD_WPA_SUPPLICANT
    help
        This enables use of hostap suite (hostapd / wpa_supplicant)
        to authenticate clients (AP role) and connecting
        to network (STA role).

        This is used on newer BCM products/driver (11ax).

endchoice

choice
    prompt "Type of nvram implementation to use"
    default BCM_NVRAM_LIB

config BCM_NVRAM_EXEC
    bool "nvram executable via fork+exec"
    help
        Historically this was the first approach. It tends to just
        work with some exception, but its biggest pitfall is slowness.
        It is resource intensive due to fork() + exec() use.

config BCM_NVRAM_LIB
    bool "wlcsm library"
    help
        This is much faster compared to BCM_NVRAM_EXEC because it does
        not spawn any additional processes via fork(). However it is
        more prone to breakage on some systems where nvram access
        was customized.

config BCM_NVRAM_NONE
    bool "none"
    help
        For platforms with custom nvram solutions the integrator
        guarantees to implement the following functions:
          bcmwl_nvram_getall
          bcmwl_nvram_get
          bcmwl_nvram_set

endchoice

if BCM_NVRAM_EXEC
config BCM_NVRAM_EXEC_PATH
    string "nvram executable path"
    default "nvram"
    help
        Normally the system tries to rely on PATH variable to find the
        binary, however on some systems PATH may not include the nvram
        by default, or may have multiple implementations. In case PATH
        cannot be easily overridden an absolute path can be specified
        here, e.g. /usr/sbin/nvram.

        If unsure, say 'nvram'
endif

config BCM_PREFER_IOV
    bool "Prefer raw ioctl() calls instead of fork()+exec(wlctl..)"
    default y
    help
        Historically for various reasons all interactions to the
        driver were performed by using wlctl and dhdctl commands. This
        means the calling process forks and execs into them.

        fork+exec can be pretty slow on older CPUs and is known to
        cause some issues. However it's the most tested implementation
        and known to work on multiple systems.

        This kconfig option (prefer raw ioctl) enables raw ioctl usage
        instead of fork+exec. The support covers only select few
        calls to speed up the worst spots.

        Select 'n' if issues are observed.

        If unsure, say 'y'.

config BCM_USE_RATE_HISTO
    bool "Use wlctl rate_histo_report to collect MCS histograms"
    default y
    help
        MCS histograms are used to infer link-quality between devices.

        These histograms can be described as a structure that is
        accessed like so:

          client[X].rate[Y].counter[Z]

        The rate is a 4-touple of preamble, bandwidth, mcs and nss.

        There are a number of counters, e.g. msdu, mpdu, ppdu, bytes.

        If using 11ax and newer devices, say 'n'.
        If using 11ac and older devices, say 'y'.

config BCM_USE_RATE_HISTO_TO_EXPECTED_TPUT
    bool "Use MCS histograms to compute expected throughput phyrates"
    default y
    depends on BCM_USE_RATE_HISTO
    help
        This makes sense only for 11ac and older devices which
        originally were intended to report MCS histograms. Some of
        them couldn't be updated to deliver (reliable) expected
        throughput phyrates. Instead MCS histograms can be utilized to
        estimate them.

        If using 11ax and newer devices, say 'n'.
        If using 11ac and older devices, say 'y'.

menuconfig BCM_WPS
    bool "Enable Wireless Protected Setup (WPS)"
    depends on BCM_USE_NAS
    default n

if BCM_WPS

config BCM_WPS_PROCESS
    string "Name WPS monitor process"
    default "wps_monitor"

config BCM_WPS_PID
    string "Full path of WPS monitor process id"
    default "/tmp/wps_monitor.pid"

menuconfig BCM_WPS_INTERFACE_LIST
    bool "WPS interface list"
    default y
    help
        Use a hardcoded WPS interface list.

if BCM_WPS_INTERFACE_LIST
    config BCM_WPS_INTERFACE0_LIST
        bool "VIF[0]"
        default y

    config BCM_WPS_INTERFACE0_NAME
        string "if_name[0]"
        depends on BCM_WPS_INTERFACE0_LIST
        default "wl0.2"

    config BCM_WPS_INTERFACE1_LIST
        bool "VIF[1]"
        default y

    config BCM_WPS_INTERFACE1_NAME
        string "if_name[1]"
        depends on BCM_WPS_INTERFACE1_LIST
        default "wl1.2"

    config BCM_WPS_INTERFACE2_LIST
        bool "VIF[2]"

    config BCM_WPS_INTERFACE2_NAME
        string "if_name[2]"
        depends on BCM_WPS_INTERFACE2_LIST

    config BCM_WPS_INTERFACE3_LIST
        bool "VIF[3]"

    config BCM_WPS_INTERFACE3_NAME
        string "if_name[3]"
        depends on BCM_WPS_INTERFACE3_LIST
endif # BCM_WPS_INTERFACE_LIST

endif # BCM_WPS

config BCM_NVRAM_IN_TMPFS
    bool "Regenerate kernel NVRAM file on every boot"
    default n
    help
        This enables re-generation of kernel NVRAM file
        on every boot and storing it in tmpfs.

        This prevents cases of kernel NVRAM file (/data/.kernel_nvram.setting)
        storing some NVRAM fields on issuing a "nvram commit",
        which should not be persistent across reboots.

        This can also prove useful when a new upgrade image
        has an updated default NVRAM file
        (/etc/wlan/kernel_nvram.setting), and you want the
        changes to be reflected in the kernel NVRAM file.

        If you enable this change and want some NVRAM field
        to be persistent across reboots, you will need to store
        it in ENVRAM or change the default NVRAM file.

        This relies on the reference BCM SDK script hndnvram.sh
        and specific functions from that script.

config BCM_SECURE_BOOT_LIB
    bool "Enable library for secure boot"
    default n
    help
        This enables library for detecting unsecure/manufacturing
        secure/field secure modes, and to burn the keys into
        OTP/SOTP. Library is also able to get current status and
        to lock JTAG access.
        If you enable this option and want to burn keys used for
        secure boot, you will have to change the default ones
        located in file bcmsb_keys.c, or override the file through
        another sublayer.
        The library uses ioctl() to call kernel module to retrieve
        the info.
        This has been tested only on the BCM 6755 SoC.

        The following options need to be used when building the
        BCM SDK image:
          BUILD_SECURE_BOOT=y
          BRCM_BUILD_SOTP_DRIVER=y
          BRCM_DRIVER_SOTP=y
          BUILD_CFE_ALLOW_NONSEC_SOTP_ACCESS=y
          BUILD_SOTPCTL=y
choice
    prompt "Hardware Acceleration"
    default BCM_FCCTL_HW_ACC

    config BCM_FCCTL_HW_ACC
        bool "Use FlowCache hardware acceleration (fcctl)"
        help
            Select for FlowCache hardware acceleration (fcctl).

    config BCM_FLOW_MGR_HW_ACC
        bool "Use FAP hardware acceleration (flowmgr)"
        help
            Select for FAP hardware acceleration (flowmgr).
endchoice

config BCM_USE_TOAD
    bool "Use toad daemon for SSID prioritization"
    default n
    help
        This enables driving userspace daemons of TOAD daemon
        handling.
        By enabling this option SSID prioritization between
        public and private AP can be achieved.

config BCM_TOAD_PATH
    string "Path to toad binaries"
    default "/usr/bin/toad"

config BCMWL_HE_FEATURES
    string "wl he features flags"
    default "3"
    help
        Using -1 will enable all features that a radio supports
        wl he features [<features mask>] - query or enable/disable HE sub-features
        0x01: HE 5G support
        0x02: HE 2G support
        0x04: HE DL OFDMA support
        0x08: HE UL OFDMA support
        0x10: HE DL MUMIMO support
        0x20: HE UL MUMIMO support
        0x40: HE STA ULMU support
        0x80: HE ER SU Rx support

config BCMWL_EHT_FEATURES
    string "wl eht features flags"
    default "7"
    help
        Using -1 will enable all features that a radio supports
        wl eht features [<features mask>] - query or enable/disable EHT sub-features
        0x01: EHT 6G support
        0x02: EHT 5G support
        0x04: EHT 2G support
        0x08: EHT DL OFDMA support
        0x10: EHT UL OFDMA support
        0x20: EHT DL MU-MIMO support
        0x40: EHT UL MU-MIMO support

config BCM_PERFORMANCE_BOOST
    bool "Performance boost"
    default y
    help
        Updates the kernel task priorities, affinities and EEE

config BCM_EEE_DISABLE_ETH_LIST
    string "The list of interfaces where you would like to disable EEE."
    default ""
    help
        The list of disabled EEE interfaces must be space delimited.
        By default there is no specified interfaces.

        List example:
        eth0 eth1 eth2

config BCM_SPEEDTEST_RT_RUNTIME
    int "RT_RUNTIME value"
    default 95000
    help
        Sets the RT_RUNTIME for speedtest priority.
endif # PLATFORM_IS_BCM
```

## src/lib/osn/kconfig/Kconfig.osn.igmp_backend
```kconfig
config OSN_BACKEND_IGMP_BCM
    bool "BCM mcpd"

    help
        Use the Broadcom `mcpd` utility for managing IGMP.

        Broadcom platforms use mcpd binary for correctly configuring IPv4
        multicast traffic.
```

## src/lib/osn/kconfig/Kconfig.osn.mld_backend
```kconfig
config OSN_BACKEND_MLD_BCM
    bool "BCM mcpd"

    help
        Use the Broadcom `mcpd` utility for managing MLD.

        Broadcom platforms use mcpd binary for correctly configuring IPv6
        multicast traffic.
```

## src/lib/osn/kconfig/Kconfig.osn.qos_backend
```kconfig
config OSN_BACKEND_QOS_BCM_ARCHER
    bool "Broadcom Archer"

    select OSN_LINUX_ENABLED
    help
        Use the Broadcom Archer propriatery QoS implementation.

        Requires BCM SDK support for Service Queues feature and a matching
        license.

config OSN_BACKEND_QOS_BCM_TMCTL
    bool "Broadcom TMCTL"

    select OSN_LINUX_ENABLED
    help
        Use the Broadcom Traffic MAnagement Control QoS implementation.

        Requires BCM SDK support for Service Queues feature and a matching
        license.
```

## src/lib/osn/kconfig/Kconfig.osn.vlan_backend
```kconfig
config OSN_BACKEND_VLAN_BCM_VLANCTL
    bool "BCM vlanctl"
    select OSN_LINUX_ENABLED
    select OSN_LINUX_VLAN
    help
        Use the Broadcom `vlanctl` utility for managing VLANs.

        Vlanctl is needed for HW acceleration and integration with other BCM
        daemons like mcpd.
```
